## conf/layer.conf
```bitbake
# We have a conf and classes directory, add to BBPATH
BBPATH .= ":${LAYERDIR}"

# We have a packages directory, add to BBFILES
BBFILES += "${LAYERDIR}/recipes-*/*/*.bb \
            ${LAYERDIR}/recipes-*/*/*.bbappend"

BBFILE_COLLECTIONS += "agronave"
BBFILE_PATTERN_agronave := "^${LAYERDIR}/"
BBFILE_PRIORITY_agronave = "9"

LAYERSERIES_COMPAT_agronave = "sumo"

BBFILES_DYNAMIC += " \
    swupdate:${LAYERDIR}/dynamic-layers/swupdate/*.bb \
    swupdate:${LAYERDIR}/dynamic-layers/swupdate/*.bbappend \
"

LICENSE_PATH += "${LAYERDIR}/licenses"
```

## conf/local.conf
```bitbake
MACHINE ??= 'imx8mq-var-dart'
DISTRO ?= 'fsl-imx-wayland'
IMAGE_FEATURES += "package-management"
PACKAGE_CLASSES ?= "package_rpm"
EXTRA_IMAGE_FEATURES ?= "debug-tweaks"
USER_CLASSES ?= "buildstats image-mklibs image-prelink"
PATCHRESOLVE = "noop"
BB_DISKMON_DIRS ??= "\
    STOPTASKS,${TMPDIR},1G,100K \
    STOPTASKS,${DL_DIR},1G,100K \
    STOPTASKS,${SSTATE_DIR},1G,100K \
    STOPTASKS,/tmp,100M,100K \
    ABORT,${TMPDIR},100M,1K \
    ABORT,${DL_DIR},100M,1K \
    ABORT,${SSTATE_DIR},100M,1K \
    ABORT,/tmp,10M,1K"
PACKAGECONFIG_append_pn-qemu-native = " sdl"
PACKAGECONFIG_append_pn-nativesdk-qemu = " sdl"
CONF_VERSION = "1"

PARALLEL_MAKE = "-j 6"

DL_DIR ?= "${BSPDIR}/downloads/"
ACCEPT_FSL_EULA = "1"

EXTRA_IMAGE_FEATURES = " \
    debug-tweaks \
    tools-debug \
    eclipse-debug \
    "

PACKAGECONFIG ??= "qtdeclarative qtquick"

IMAGE_INSTALL_append = " \
    tcf-agent \
    openssh-sftp-server \
    qtbase \    
    qtbase-plugins \     
    qtbase-tools \        
    qtmultimedia \     
    qtmultimedia-plugins \     
    qtmultimedia-qmlplugins \     
    qtsvg \     
    qtsvg-plugins \     
    qtsensors \     
    qtimageformats-plugins \     
    qtsystems \     
    qtsystems-tools \          
    qtsystems-qmlplugins \     
    qtscript \     
    qt3d \     
    qt3d-qmlplugins \     
    qt3d-tools \     
    qtgraphicaleffects-qmlplugins \     
    qtconnectivity-qmlplugins \     
    qtlocation-plugins \     
    qtlocation-qmlplugins \     
    qtserialbus \
    qtserialport \
    qtgraphicaleffects \
    qtlocation \
    qtserialbus \
    qtquickcontrols2-qmlplugins \
    qttools-plugins \
    qtxmlpatterns \
    qtvirtualkeyboard \
    qtvirtualkeyboard-plugins \
    qtvirtualkeyboard-qmlplugins \
    agr-can \
    agr-m4 \
    rpm \
    yavta \
    v4l-utils \    
"

TOOLCHAIN_HOST_TASK_append = " nativesdk-qt3d-tools nativesdk-qt3d"

#DISTRO_FEATURES_append = " X11"

IMAGE_FEATURES_remove = " \
   psplash \
   "

IMAGE_INSTALL_remove = " \
    psplash \
    imx-test \
    opencv \
    opencv-apps \
    opencv-samples \
    python3-opencv \
    pulseaudio \
    quitbattery \
    sqlite3 \
    qt5-demo-extrafiles \
    dbus-test \
    protobuf-native \
    gcc-cross-aarch64 \
    gcc-source-8.3.0 \
    qtx11extras \
    quitbattery \
    sqlite3-native \
    ninja-native \
    packagegroup-qt5-demos \
    qt5everywheredemo \
    u-boot-fw-utils \
   "

#CORE_IMAGE_EXTRA_INSTALL_remove = " \
#    packagegroup-fsl-tools-testapps \
#    packagegroup-fsl-tools-benchmark \
#    packagegroup-fsl-tools-audio \
#    " 
```
